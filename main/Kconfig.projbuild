## main/Kconfig.projbuild
```kconfig
menu "App-Specific Configuration"

config WIFI_SSID
    string "WiFi SSID"
        default "myssid"
        help
            SSID of target AP

config WIFI_PASSWORD
    string "WiFi Password"
        default "mypassword"
        help
            WiFi password off target AP

config AWS_CLIENT_ID
	string "AWS Client ID"
		default "esp32"
		help
			Client ID of AWS IoT Hub connection

endmenu
```
